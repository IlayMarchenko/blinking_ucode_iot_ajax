/**
 * @cliArgs --board "/ti/boards/CC1352R1_LAUNCHXL" --product "simplelink_cc13x2_26x2_sdk@4.30.00.54"
 * @versions {"data":"2020090214","timestamp":"2020090214","tool":"1.6.0+1543","templates":"2020090214"}
 */

/**
 * Import the modules used in this configuration.
 */
const RTOS = scripting.addModule("/ti/drivers/RTOS");
const LED  = scripting.addModule("/ti/drivers/apps/LED", {}, false);
const LED1 = LED.addInstance();
const LED2 = LED.addInstance();

/**
 * Write custom configuration values to the imported modules.
 */
LED1.$hardware                 = system.deviceData.board.components.LED_RED;
LED1.$name                     = "CONFIG_GPIO_LED_0";
LED1.gpioPin.pinInstance.$name = "CONFIG_PIN_0";

const CCFG              = scripting.addModule("/ti/devices/CCFG", {}, false);
CCFG.ccfgTemplate.$name = "ti_devices_CCFGTemplate0";

LED2.$hardware                 = system.deviceData.board.components.LED_GREEN;
LED2.$name                     = "CONFIG_GPIO_LED_1";
LED2.gpioPin.pinInstance.$name = "CONFIG_PIN_1";

/**
 * Pinmux solution for unlocked pins/peripherals. This ensures that minor changes to the automatic solver in a future
 * version of the tool will not impact the pinmux you originally saw.  These lines can be completely deleted in order to
 * re-solve from scratch.
 */
LED1.gpioPin.gpioPin.$suggestSolution = "boosterpack.39";
LED2.gpioPin.gpioPin.$suggestSolution = "boosterpack.40";
